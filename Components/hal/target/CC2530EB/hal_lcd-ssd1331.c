/****************************************************************************
* Filename: hal_lcd.c
* Description: OLED driver
****************************************************************************/
#include "hal_types.h"
#include "hal_lcd.h"
#include "OSAL.h"
#include "OnBoard.h"
#include "hal_assert.h"
#include <string.h>

#ifdef OLED_1331

#if defined (ZTOOL_P1) || defined (ZTOOL_P2)
  #include "DebugTrace.h"
#endif

#define LCD_SCL P1_2       //SCLK  时钟 D0（SCLK）
#define LCD_SDA P1_3       //SDA   D1（MOSI） 数据
#define LCD_RST P1_7       //_RES  hardware reset   复位 
#define LCD_DC  P0_0       //A0  H/L 命令数据选通端，H：数据，L:命令

#define   red     0xF800
#define   green   0x07E0
#define   blue    0x001F
#define   black   0x0000
#define   white   0xFFFF


#define XLevelL            0x00
#define XLevelH            0x10
#define XLevel             ((XLevelH&0x0F)*16+XLevelL)
#define Max_Column         128
#define Max_Row            64
#define Brightness         0xCF 
#define X_WIDTH            128
#define Y_WIDTH            64

#define LCD_MAX_BUF        25
#define HAL_LCD_MAX_CHARS  16   // Max number of chars on a single LCD line 

//英文编码为0~127，所以大于127的中文
#define IS_CHINESE(x)       (((unsigned char)(x))>(unsigned char)0x7f )

uint16 hz_clor=0x001f;  //蓝色

//纵向取模

const unsigned char ascii_table_8x16[95][16]={

//粗体8x16点阵的ASCII码的点阵数据，从"JLX-GB2312"型号的字库IC中读出来的国标的。
0x00,0x00,0x00,0x00, 0x00,0x00,0x00,0x00, 0x00,0x00,0x00,0x00, 0x00,0x00,0x00,0x00,		//- -(即“空格”）ASCII码：0X20
0x00,0x00,0x38,0xFC, 0xFC,0x38,0x00,0x00, 0x00,0x00,0x00,0x0D, 0x0D,0x00,0x00,0x00,		//-!-			ASCII码：0X21
0x00,0x0E,0x1E,0x00, 0x00,0x1E,0x0E,0x00, 0x00,0x00,0x00,0x00, 0x00,0x00,0x00,0x00,  	//-"-
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0x08,0x0C,0x04,0x0C, 0x08,0x0C,0x04,0x00, 0x00,0x00,0x00,0x00, 0x00,0x00,0x00,0x00,		//-~-		   ASCII码：0X7E

};

const unsigned char ascii_table_5x8[95][5]={
/*全体ASCII 列表:5x8点阵*/
0x00,0x00,0x00,0x00,0x00,//- -   //space
0x00,0x00,0x4f,0x00,0x00,//-!-
0x00,0x07,0x00,0x07,0x00,//-"-
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0x04,0x02,0x02,0x02,0x01,//-~-
};

//中文字符串原字,可以理解是每个汉字的国标编码，每个汉字的国标编码是2个字节。
const unsigned char Chinese_text_16x16[] = 
{
    "深圳亿研电子研发寸彩色显示屏欢迎您"
};

typedef struct _hz_16_16_
{
    char* gpk;
    unsigned char code[32];
}hanziku;

//汉字的取模点阵代码，每个汉字由16x16位组成，即：一位对应一个点阵，共对应16x16点阵，换算：16x16=256bits=32bytes
const hanziku tabel_hanzi[] =
{
    //找不到就显示这个，两个空格
    {{"  "},
    {0x00,0x00,0x00,0x00,0x00,0x00,0x00,0x00,0x00,0x00,0x00,0x00,0x00,0x00,0x00,0x00,
    0x00,0x00,0x00,0x00,0x00,0x00,0x00,0x00,0x00,0x00,0x00,0x00,0x00,0x00,0x00,0x00}},


/*--  文字:  温  --*/
/*--  宋体12;  此字体下对应的点阵为：宽x高=16x16   --*/
    {{"温"},
    {0x10,0x21,0x86,0x70,0x00,0x7E,0x4A,0x4A,0x4A,0x4A,0x4A,0x7E,0x00,0x00,0x00,0x00,
    0x02,0xFE,0x01,0x40,0x7F,0x41,0x41,0x7F,0x41,0x41,0x7F,0x41,0x41,0x7F,0x40,0x00}},

/*--  文字:  度  --*/
/*--  宋体12;  此字体下对应的点阵为：宽x高=16x16   --*/
    {{"度"},
    {0x00,0x00,0xFC,0x04,0x24,0x24,0xFC,0xA5,0xA6,0xA4,0xFC,0x24,0x24,0x24,0x04,0x00,
    0x80,0x60,0x1F,0x80,0x80,0x42,0x46,0x2A,0x12,0x12,0x2A,0x26,0x42,0xC0,0x40,0x00}},

/*--  文字:  ：  --*/
/*--  宋体12;  此字体下对应的点阵为：宽x高=16x16   --*/
    {{"："},
    {0x00,0x00,0x00,0x00,0x00,0x00,0x00,0x00,0x00,0x00,0x00,0x00,0x00,0x00,0x00,0x00,
    0x00,0x00,0x36,0x36,0x00,0x00,0x00,0x00,0x00,0x00,0x00,0x00,0x00,0x00,0x00,0x00}},

/*--  文字:  湿  --*/
/*--  宋体12;  此字体下对应的点阵为：宽x高=16x16   --*/
    {{"湿"},
    {0x10,0x60,0x02,0xCC,0x00,0x00,0x3E,0x2A,0xAA,0x2A,0xAA,0x2A,0x3E,0x00,0x00,0x00,
    0x08,0x08,0xFE,0x01,0x40,0x42,0x4C,0x40,0x7F,0x40,0x7F,0x48,0x44,0x42,0x40,0x00}},

    /*--  文字:  光  --*/
    /*--  楷体_GB231212;  此字体下对应的点阵为：宽x高=16x16   --*/
    {{"光"},
    {0x40,0x40,0x42,0x44,0x58,0xC0,0x40,0x7F,0x40,0xC0,0x50,0x48,0x46,0x40,0x40,0x00,
    0x80,0x80,0x40,0x20,0x18,0x07,0x00,0x00,0x00,0x3F,0x40,0x40,0x40,0x40,0x78,0x00}},

    /*--  文字:  照  --*/
    /*--  楷体_GB231212;  此字体下对应的点阵为：宽x高=16x16   --*/
    {{"照"},
    {0x00,0xFE,0x42,0x42,0x42,0xFE,0x00,0x42,0xA2,0x9E,0x82,0xA2,0xC2,0xBE,0x00,0x00,
    0x80,0x6F,0x08,0x08,0x28,0xCF,0x00,0x00,0x2F,0xC8,0x08,0x08,0x28,0xCF,0x00,0x00}},

    /*--  文字:  大  --*/
    /*--  宋体12;  此字体下对应的点阵为：宽x高=16x16   --*/
    {{"大"},
    {0x20,0x20,0x20,0x20,0x20,0x20,0x20,0xFF,0x20,0x20,0x20,0x20,0x20,0x20,0x20,0x00,
    0x80,0x80,0x40,0x20,0x10,0x0C,0x03,0x00,0x03,0x0C,0x10,0x20,0x40,0x80,0x80,0x00}},

    /*--  文字:  小  --*/
    /*--  宋体12;  此字体下对应的点阵为：宽x高=16x16   --*/
    {{"小"},
    {0x00,0x00,0x00,0xE0,0x00,0x00,0x00,0xFF,0x00,0x00,0x00,0x20,0x40,0x80,0x00,0x00,
    0x08,0x04,0x03,0x00,0x00,0x40,0x80,0x7F,0x00,0x00,0x00,0x00,0x00,0x01,0x0E,0x00}},

    /*--  文字:  于  --*/
    /*--  宋体12;  此字体下对应的点阵为：宽x高=16x16   --*/
    {{"于"},
    {0x40,0x40,0x42,0x42,0x42,0x42,0x42,0xFE,0x42,0x42,0x42,0x42,0x42,0x40,0x40,0x00,
    0x00,0x00,0x00,0x00,0x00,0x40,0x80,0x7F,0x00,0x00,0x00,0x00,0x00,0x00,0x00,0x00}},

    /*--  文字:  报  --*/
    /*--  宋体12;  此字体下对应的点阵为：宽x高=16x16   --*/
    {{"报"},
    {0x10,0x10,0x10,0xFF,0x10,0x90,0x00,0xFE,0x82,0x82,0x82,0x92,0xA2,0x9E,0x00,0x00,
    0x04,0x44,0x82,0x7F,0x01,0x00,0x00,0xFF,0x80,0x43,0x2C,0x10,0x2C,0x43,0x80,0x00}},

    /*--  文字:  警  --*/
    /*--  宋体12;  此字体下对应的点阵为：宽x高=16x16   --*/
    {{"警"},
    {0x12,0xEA,0xAF,0xAA,0xEA,0x0F,0xFA,0x02,0x88,0x8C,0x57,0x24,0x54,0x8C,0x84,0x00,
    0x02,0x02,0xEA,0xAA,0xAA,0xAB,0xAA,0xAB,0xAA,0xAA,0xAA,0xAA,0xEA,0x02,0x02,0x00}},
};



#if (HAL_LCD == TRUE)
void init_SSD1331(void);
void HalLcd_HW_WaitUs(uint16 i);
void HalLcd_HW_Clear(void);
void HalLcd_HW_Control(uint8 cmd);
void HalLcd_HW_Write(uint8 data);
void HalLcd_HW_SetContrast(uint8 value);
void HalLcd_HW_WriteChar(uint8 line, uint8 col, char text);
void HalLcd_HW_WriteLine(uint8 line, const char *pText);

void DelayMS(unsigned int msec);
void LCD_DLY_ms(unsigned int ms);
void LCD_WrDat(unsigned char dat);
void LCD_WrCmd(unsigned char cmd);
void LCD_Set_Pos(unsigned char x, unsigned char y);
void LCD_Fill(unsigned char bmp_dat) ;
void LCD_CLS(void);
void LcdClearLine(unsigned char y, unsigned char count);

void LCD_P8x16Str(unsigned char x, unsigned char y,unsigned char ch[]);
void HalLcdDisplayPercentBar( char *title, uint8 value );
void LCD_P16x16Ch(unsigned char x, unsigned char y, unsigned char N);

void display_string_8x16(uint8 row,uint8 column,uint8 *text);
void display_string_5x8(uint8 row,uint8 column,uint8 reverse,uint8 *text);
void disp_string_8x16_16x16(uint8 row,uint8 column,uint8 *text); 
#endif //LCD


/**************************************************************************************************
 * @fn      HalLcdInit
 *
 * @brief   Initilize LCD Service
 *
 * @param   init - pointer to void that contains the initialized value
 *
 * @return  None
 **************************************************************************************************/
void HalLcdInit(void)
{
#if (HAL_LCD == TRUE)
  init_SSD1331();
#endif
}

/**************************************************************************************************
 * @fn      HalLcdWriteValue
 *
 * @brief   Write a value to the LCD
 *
 * @param   value  - value that will be displayed
 *          radix  - 8, 10, 16
 *          option - display options
 *
 * @return  None
 **************************************************************************************************/
void HalLcdWriteValue ( uint32 value, const uint8 radix, uint8 option)
{
#if (HAL_LCD == TRUE)
  uint8 buf[LCD_MAX_BUF];

  _ltoa( value, &buf[0], radix );
  HalLcdWriteString( (char*)buf, option );
#endif
}

/**************************************************************************************************
 * @fn      HalLcdWriteScreen
 *
 * @brief   Write a value to the LCD
 *
 * @param   line1  - string that will be displayed on line 1
 *          line2  - string that will be displayed on line 2
 *
 * @return  None
 **************************************************************************************************/
void HalLcdWriteScreen( char *line1, char *line2 )
{
#if (HAL_LCD == TRUE)
  HalLcdWriteString( line1, 1 );
  HalLcdWriteString( line2, 2 );
#endif
}

/**************************************************************************************************
 * @fn      HalLcdWriteStringValue
 *
 * @brief   Write a string followed by a value to the LCD
 *
 * @param   title  - Title that will be displayed before the value
 *          value  - value
 *          format - redix
 *          line   - line number
 *
 * @return  None
 **************************************************************************************************/
void HalLcdWriteStringValue( char *title, uint16 value, uint8 format, uint8 line )
{
#if (HAL_LCD == TRUE)
  uint8 tmpLen;
  uint8 buf[LCD_MAX_BUF];
  uint32 err;

  tmpLen = (uint8)osal_strlen( (char*)title );
  osal_memcpy( buf, title, tmpLen );
  //buf[tmpLen] = ' ';
  err = (uint32)(value);
  _ltoa( err, &buf[tmpLen], format );
  HalLcdWriteString( (char*)buf, line );		
#endif
}

/**************************************************************************************************
 * @fn      HalLcdWriteStringValue
 *
 * @brief   Write a string followed by a value to the LCD
 *
 * @param   title   - Title that will be displayed before the value
 *          value1  - value #1
 *          format1 - redix of value #1
 *          value2  - value #2
 *          format2 - redix of value #2
 *          line    - line number
 *
 * @return  None
 **************************************************************************************************/
void HalLcdWriteStringValueValue( char *title, uint16 value1, uint8 format1,
                                  uint16 value2, uint8 format2, uint8 line )
{

#if (HAL_LCD == TRUE)

  uint8 tmpLen;
  uint8 buf[LCD_MAX_BUF];
  uint32 err;

  tmpLen = (uint8)osal_strlen( (char*)title );
  if ( tmpLen )
  {
    osal_memcpy( buf, title, tmpLen );
    //buf[tmpLen++] = ' ';
  }

  err = (uint32)(value1);
  _ltoa( err, &buf[tmpLen], format1 );
  tmpLen = (uint8)osal_strlen( (char*)buf );

  buf[tmpLen++] = ',';
  buf[tmpLen++] = ' ';
  err = (uint32)(value2);
  _ltoa( err, &buf[tmpLen], format2 );

  HalLcdWriteString( (char *)buf, line );		

#endif
}

#if (HAL_LCD == TRUE)

/*********************LCD全屏************************************/
void LCD_Fill(unsigned char bmp_dat) 
{
}

void LCD_SetColor(uint16 c)
{
  hz_clor=c;
}

void LcdClearLine(unsigned char y, unsigned char count)
{

}

void HalLcdWriteString (char *str, uint8 option)
{
  uint8 x=0,y=0,strLen;
  uint8 lcdBuf[HAL_LCD_MAX_CHARS+1];
    
  x=0;
  y = (option-1)*8;
  strLen = (uint8)osal_strlen( (char*)str );

  /* Check boundries */
  if ( strLen > HAL_LCD_MAX_CHARS )
    strLen = HAL_LCD_MAX_CHARS;

  osal_memset(lcdBuf, 0, HAL_LCD_MAX_CHARS+1);
  osal_memcpy( lcdBuf, str, strLen );

  //设置每一行字的颜色
  if(option==HAL_LCD_LINE_1)
  {
    LCD_SetColor(red);
  }
  else if(option==HAL_LCD_LINE_2)
  {
    LCD_SetColor(blue);
  }
  else if(option==HAL_LCD_LINE_3)
  {
    LCD_SetColor(blue);
  }
  else if(option==HAL_LCD_LINE_4)
  {
    LCD_SetColor(blue);
  }
  else if(option==HAL_LCD_LINE_5)
  {
    LCD_SetColor(blue);
  }
  else if(option==HAL_LCD_LINE_6)
  {
    LCD_SetColor(blue);
  }
  else if(option==HAL_LCD_LINE_7)
  {
    LCD_SetColor(blue);
  }
  else if(option==HAL_LCD_LINE_8)
  {
    LCD_SetColor(blue);
  }

  display_string_5x8(y, 0, 0, lcdBuf);
}

/***能描述：显示8*16一组标准ASCII字符串     显示的坐标（x,y），y为页范围0～7***/
void LCD_P8x16Str(unsigned char x, unsigned char y,unsigned char ch[])
{
    unsigned char c=0,i=0,j=0;
    unsigned char* addr=0;
    unsigned char wm=0;

    display_string_8x16(y, x, ch);  //显示字母
}

void DelayMS(unsigned int msec)
{ 
    unsigned int i,j;
    
    for (i=0; i<msec; i++)
        for (j=0; j<600; j++);
}

void asm_delay()
{
//    asm("nop"); 
//    asm("nop"); 
//    asm("nop");
}

void write_com(unsigned char data1)
{
    uint8 i;
    //  lcd_cs1=0;
    LCD_DC=0;  
  //  asm_delay();

    for(i=0;i<8;i++)
    {
        LCD_SCL = 0;    
        if (data1 & 0x80)
        {
          LCD_SDA = 1;
        }
        else
        {
          LCD_SDA = 0;
        }

//        asm_delay();
        LCD_SCL = 1; 
  //      asm_delay();
        data1 <<= 1;    
    }
  //  lcd_cs1=1;
}

void write_dat(unsigned char data1)
{
    uint8 i;
    // lcd_cs1=0;
    LCD_DC= 1;
   // asm_delay();
   
    for(i=0;i<8;i++)
    {
        LCD_SCL = 0;    
        if (data1 & 0x80)
        {
          LCD_SDA = 1;
        }
        else
        {
          LCD_SDA = 0;
        }
        
      //  asm_delay();
        LCD_SCL = 1;
      //  asm_delay();
        data1 <<= 1;    
    }
 //   lcd_cs1=1;
}

void RAM_ADDRESS(void)
{ 
  write_com(0x15);
  write_com(0x00);
  write_com(0x5f);

  write_com(0x75);
  write_com(0x00);
  write_com(0x3f);
}

//全屏清屏  黑色
void clear_screen()
{
  int i,j;
  RAM_ADDRESS();
  for(i=0;i<96;i++) 
  {
    for(j=0;j<64;j++)
    {
      write_dat(0x00);//RAM data write
      write_dat(0x00);//RAM data write
    }
  }
}

void LCD_CLS(void)
{
  clear_screen();
}


void  set_address(uint8 row,uint8 column)
{
  write_com(0x15);	  
  write_com(column);	//X start 
  write_com(column);	//X end 

  write_com(0x75);	
  write_com(row);	//Y start 
  write_com(row+7);	//Y end 			
}


void transfer_data(uint8 data1) 
{
  uint8 i; 
  uint8 clorh=hz_clor>>8; 
  uint8 clorl=hz_clor&0x00ff;

  for(i=0;i<8;i++)
  {
    if (data1& 0x01)	
    { 	
      write_dat(clorh);   //设置字体颜色
      write_dat(clorl);
    }
    else  			
    {
      write_dat(0x00);   //设置背景白色
      write_dat(0x00);
    }

    data1>>= 1;
  }
}


void init_SSD1331()
{
  P0SEL &= ~0x11; //让P0.0为普通IO口，
  P0DIR |= 0x11; //让P0.0为为输出
  
  P1SEL &= ~0x8C; //让 P1.2 P1.3 P1.7为普通IO口
  P1DIR |= 0x8C; //把 P1.2 P1.3 1.7设置为输出

//  lcd_cs1 =0;  
  LCD_RST=0;
  DelayMS(10);
  LCD_RST=1;
  DelayMS(10);
  
  write_com(0xfd);	// command lock
  write_com(0x12);
  write_com(0xae);	// display off
  write_com(0xa4); 	// Normal Display mode
  
  write_com(0x15);	//set column address
  write_com(0x00);	//column address start 00
  write_com(0x5f);	//column address end 95
  write_com(0x75);	//set row address
  write_com(0x00);	//row address start 00
  write_com(0x3f);	//row address end 63	
  
  write_com(0x87);	//master current control
  write_com(0x03);	//9/16(160uA)---??????,????(0x0a)
  
  write_com(0x83);	//Set Contrast for Color R
  write_com(0xA0);
  write_com(0x82);	//Set Contrast for Color G
  write_com(0xA0);
  write_com(0x81);	//Set Contrast for Color B
  write_com(0xA0);
  
  write_com(0x8a);
  write_com(0x61);
  write_com(0x8b);
  write_com(0x62);
  write_com(0x8c);
  write_com(0x63);
  
  write_com(0xa0);	//set re-map & data format
  write_com(0x72);	//Horizontal address increment
  
  write_com(0xa1);	//set display start line
  write_com(0x00);	//start 00 line
  write_com(0xa2);	//set display offset
  write_com(0x00);
  write_com(0xa8);	//set multiplex ratio
  write_com(0x3f);	//64MUX

  
  write_com(0xad);  
  write_com(0x8f);
  
  
  
  write_com(0xb0);	//set power save
  write_com(0x00);	//
  
  write_com(0xb1);
  write_com(0x11);	// Phase 2 period Phase 1 period  ???????
  write_com(0xb3);	// Set Display Clock Divide Ratio/ Oscillator Frequency
  write_com(0xF0);	// 0.97MHZ
  
  write_com(0xbb);	// set pre-charge
  write_com(0x3e);	// ---??????????
  write_com(0xbe);	//set Vcomh
  write_com(0x3e);	//0.83Vref
  
  
  
  write_com(0xad);	//Select external VCC supply at Display ON
  write_com(0x8e); 	//Select External VP voltage supply
  
  clear_screen();
  write_com(0xaf);	 //display on
  
}

void display_clor(uint8 clor1,uint8 clor2)
{
  int i,j;
  RAM_ADDRESS();
  for(i=0;i<96;i++) 
  {
    for(j=0;j<64;j++)
    {
      write_dat(clor1);//RAM data write
      write_dat(clor2);//RAM data write
    }
  }
}


//显示8x16的点阵的字符串，括号里的参数分别为（页,列，字符串指针）
void display_string_8x16(uint8 row,uint8 column,uint8 *text)
{
	uint16 i=0,j,k,n;
	if(column>89)
	{
		column=1;

	}
	while(text[i]>0x00)
	{	
		if((text[i]>=0x20)&&(text[i]<=0x7e))
		{
			j=text[i]-0x20;
			for(n=0;n<2;n++)
			{			
				for(k=0;k<8;k++)
				{					
					set_address(n*8+row,column+k);
				transfer_data(ascii_table_8x16[j][k+8*n]);	//写数据到LCD  
				}
			}
			i++;
			column+=8;
		}
		else
		i++;
	}
}



//显示5x8的点阵的字符串，括号里的参数分别为（页,列，字符串指针）
void display_string_5x8(uint8 row,uint8 column,uint8 reverse,uint8 *text)
{
  uint16 i=0,j,k,disp_data;
  while(text[i]>0x00)
  {	
    if((text[i]>=0x20)&&(text[i]<=0x7e))
    {
      j=text[i]-0x20;
      //		lcd_address(page,column);
      for(k=0;k<5;k++)
      {
        if(reverse==1)
        {
        disp_data=~ascii_table_5x8[j][k];
        }
        else
        {
        disp_data=ascii_table_5x8[j][k];
        }
        set_address(row,column+k);
        transfer_data(disp_data);	//写数据到LCD,每写完1字节的数据后列地址自动加1
      }
      
      set_address(row,column+5);   
      if(reverse==1)	transfer_data(0xff);	//写入一列空白列，使得5x8的字符与字符之间有一列间隔，更美观
      else	transfer_data(0x00);			//写入一列空白列，使得5x8的字符与字符之间有一列间隔，更美观
      i++;
      column+=6;
      if(column>91)
      {
        column=1;
      }
    }
    else
    i++;
  }
}

unsigned char* getChineseCode(char* chinese)
{
    int i;
    int tableLen=sizeof(tabel_hanzi)/sizeof(tabel_hanzi);

    if(chinese==0);

    for(i=0; i<tableLen; i++)
    {
        if(tabel_hanzi[i].gpk[0]==chinese[0] && tabel_hanzi[i].gpk[1]==chinese[1])
        {
            return (unsigned char*)tabel_hanzi[i].code;
        }
    }

    return (unsigned char*)tabel_hanzi[0].code;
}

//写入一组16x16点阵的汉字字符串（字符串表格中需含有此字）
//括号里的参数：(页，列，汉字字符串）

#if 1
void display_string_16x16(uint8 row,uint8 column,uint8 *text)
{
    uint8 i,j,k;
    unsigned char* addr=0;
    
    
    j = 0;
    while(text[j] != '\0')
    {
        i = 0;
        addr=getChineseCode(&text[j]);
        
        if(column > 81)
        {
            column = 0;
        }

        for(i = 0; i < 16; i++)               
        {
          set_address(k*8+row,column+i);
          transfer_data(*(addr+i));     
        }
        
        column+=16;
    }
}

#else

void display_string_16x16(uint8 row,uint8 column,uint8 *text)
{
    uint8 i,j,k;
    uint16 address; 
    
    j = 0;
    while(text[j] != '\0')
    {
        i = 0;
        address = 1;
        while(Chinese_text_16x16[i] > 0x7e)	  // >0x7f即说明不是ASCII码字符
        {
            if(Chinese_text_16x16[i] == text[j])
            {
                if(Chinese_text_16x16[i + 1] == text[j + 1])
                {
                    address = i * 16;
                    break;
                }
            }
            i += 2;            
        }
        
        if(column > 81)
        {
            column = 0;

        }
        
        if(address != 1)// 显示汉字                   
        {
            
			for(k=0;k<2;k++)
			{
			
	            for(i = 0; i < 16; i++)               
	            {
	                set_address(k*8+row,column+i);
					transfer_data(Chinese_code_16x16[address]);     
	                address++;
	            }
   			}
            j += 2;        
        }
        else              //显示空白字符            
        {
			for(k=0;k<2;k++)
			{
			
	            for(i = 0; i < 16; i++)               
	            {
	               set_address(k*8+row,column+i);
				    transfer_data(0x00);   
	            }
   			}
            
            j++;
        }
        
        column+=16;
    }
}
#endif

void disp_string_8x16_16x16(uint8 row,uint8 column,uint8 *text)
{
    uint8 temp[3];
    uint8 i = 0;    
    
    while(text[i] != '\0')
    {
        if(text[i] > 0x7e)
        {
            temp[0] = text[i];
            temp[1] = text[i + 1];
            temp[2] = '\0';          //汉字为两个字节
            display_string_16x16(row,column,temp);  //显示汉字
            column += 16;
            i += 2;
        }
        else
        {
            temp[0] = text[i];    
            temp[1] = '\0';          //字母占一个字节
            display_string_8x16(row, column, temp);  //显示字母
            column += 8;
            i++;
        }
    }
}

#endif

#endif
